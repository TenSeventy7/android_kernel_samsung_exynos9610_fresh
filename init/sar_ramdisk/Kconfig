## init/sar_ramdisk/Kconfig
```kconfig
menu "Android ramdisk loader"

config ANDROID_SAR_RAMDISK
	bool "Load ramdisk from boot.img"
	default y if ANDROID_SYSTEM_AS_ROOT
	help
	  Support for loading a ramdisk from a
	  partition containing an Android boot.img.
	  Useful if your bootloader doesn't load
	  the ramdisk.

if ANDROID_SAR_RAMDISK

config ANDROID_BOOT_PARTITION
	string "Android boot partition"
	default "/dev/sda14"

endif

endmenu
```
